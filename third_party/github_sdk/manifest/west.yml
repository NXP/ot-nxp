## third_party/github_sdk/manifest/west.yml
```yaml
# The west manifest file (west.yml) for MCUXpresso SDK delivery.
#
# See the west documentation for more information:
#
# https://docs.zephyrproject.org/latest/guides/west/index.html
manifest:
  projects:
  - name: sdk-release
    url: ssh://git@bitbucket.sw.nxp.com/mcucore/mcu-sdk-github-release.git
    revision: release/2.15.100_minor_rfp
    import:
      file: west_2.15.100_minor_RC1.yml
      name-allowlist:
        - mcux-sdk
        - FreeRTOS-Kernel
        - mcux-sdk-middleware-sdmmc
        - CMSIS_5
        - mbedtls
        - littlefs
        - lwip
      path-prefix: repo
  - name: wifi_nxp
    url: ssh://git@bitbucket.sw.nxp.com/mcucore/mcux-sdk-wifi-nxp.git
    revision: c4c6bee926c65518af26b03ad8182e65e7e82909
    path: repo/middleware/wifi_nxp
  - name: mcux-sdk-middleware-connectivity-framework
    url: ssh://git@bitbucket.sw.nxp.com/mcucore/mcux-sdk-middleware-connectivity-framework.git
    revision: afe4811ed28bdcff6759d0765a59e0b526f16f51
    path: repo/middleware/wireless/framework
```

## third_party/github_sdk/sdk_2.15.1/manifest/west.yml
```yaml
# The west manifest file (west.yml) for MCUXpresso SDK delivery.
#
# See the west documentation for more information:
#
# https://docs.zephyrproject.org/latest/guides/west/index.html
manifest:
  projects:
  - name: sdk-release
    url: ssh://git@bitbucket.sw.nxp.com/mcucore/mcu-sdk-github-release.git
    revision: release/2.15.100_minor_rfp
    import:
      file: west.yml
      name-allowlist:
        - mcux-sdk
        - FreeRTOS-Kernel
        - mcux-sdk-middleware-sdmmc
        - CMSIS_5
        - mbedtls
        - littlefs
        - lwip
        - wifi_nxp
        - mcux-sdk-middleware-connectivity-framework
```

## third_party/rt1060_sdk/repo/manifest/west.yml
```yaml
# The west manifest file (west.yml) for MCUXpresso SDK delivery.
#
# See the west documentation for more information:
#
# https://docs.zephyrproject.org/latest/guides/west/index.html
manifest:
  remotes:
  - name: nxpmicro
    url-base: https://github.com/NXPmicro
  defaults:
    remote: nxpmicro
  projects:
  - name: mcux-sdk
    revision: fca7db8476bd9c3dbf6805494b440f359aa2be37
    path: core
    import:
      name-allowlist:
        - FreeRTOS-Kernel
        - mcux-sdk-middleware-sdmmc
        - fatfs
        - mbedtls
        - littlefs
  - name: framework
    url: https://github.com/NXP/mcux-sdk-middleware-connectivity-framework.git
    revision: 99d867efa1b7f8c4b90862478dd
    path: middleware/wireless/framework    
```
